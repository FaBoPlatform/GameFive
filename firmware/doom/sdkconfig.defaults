## firmware/doom/sdkconfig.defaults
```kconfig
CONFIG_IDF_TARGET="esp32s3"
CONFIG_ESPTOOLPY_FLASHSIZE_8MB=y
CONFIG_ESP_CONSOLE_USB_SERIAL_JTAG=y

# XIAO ESP32-S3 is ESP32-S3R8: 8MB octal PSRAM. Doom's zone allocator is
# plain malloc, so SPIRAM_USE_MALLOC feeds it from PSRAM; small allocations
# (< 16KB) stay internal for speed.
CONFIG_SPIRAM=y
CONFIG_SPIRAM_MODE_OCT=y
CONFIG_SPIRAM_SPEED_80M=y
CONFIG_SPIRAM_USE_MALLOC=y
CONFIG_SPIRAM_MALLOC_ALWAYSINTERNAL=16384

CONFIG_COMPILER_OPTIMIZATION_PERF=y
CONFIG_ESP_DEFAULT_CPU_FREQ_MHZ_240=y
CONFIG_FREERTOS_HZ=1000

# The doom engine loop never idles when render-bound; don't let the task
# watchdog kill it (arkadijs/retro-go ports do the same).
CONFIG_ESP_TASK_WDT_EN=n

CONFIG_PARTITION_TABLE_CUSTOM=y
CONFIG_PARTITION_TABLE_CUSTOM_FILENAME="partitions.csv"
```

## firmware/launcher/sdkconfig.defaults
```kconfig
CONFIG_IDF_TARGET="esp32s3"
CONFIG_ESPTOOLPY_FLASHSIZE_8MB=y
CONFIG_ESP_CONSOLE_USB_SERIAL_JTAG=y
CONFIG_COMPILER_OPTIMIZATION_PERF=y
CONFIG_ESP_DEFAULT_CPU_FREQ_MHZ_240=y
CONFIG_PARTITION_TABLE_CUSTOM=y
CONFIG_PARTITION_TABLE_CUSTOM_FILENAME="partitions.csv"
```

## firmware/snake/sdkconfig.defaults
```kconfig
# Game Five hwtest — XIAO ESP32-S3
CONFIG_IDF_TARGET="esp32s3"

# 8 MB flash on the XIAO ESP32-S3
CONFIG_ESPTOOLPY_FLASHSIZE_8MB=y

# Console over the XIAO's USB-C (native USB Serial/JTAG)
CONFIG_ESP_CONSOLE_USB_SERIAL_JTAG=y

# Game Five store layout (launcher/ota_0/assets)
CONFIG_PARTITION_TABLE_CUSTOM=y
CONFIG_PARTITION_TABLE_CUSTOM_FILENAME="partitions.csv"
```
